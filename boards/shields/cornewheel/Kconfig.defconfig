## boards/shields/cornewheel/Kconfig.defconfig
```kconfig
if SHIELD_CORNEWHEEL_LEFT

# Name must be less than 16 characters long!
config ZMK_CORNEWHEEL
    default "Corne Wheel"

config ZMK_SPLIT_ROLE_CENTRAL
    default y

endif

if SHIELD_CORNEWHEEL_LEFT || SHIELD_CORNEWHEEL_RIGHT

config ZMK_SPLIT
    default y

endif
```

## boards/shields/cornewheel/Kconfig.shield
```kconfig
# No whitespace after the comma or in your part name!
config SHIELD_CORNEWHEEL_LEFT
    def_bool $(shields_list_contains,cornewheel_left)

# No whitespace after the comma or in your part name!
config SHIELD_CORNEWHEEL_RIGHT
    def_bool $(shields_list_contains,cornewheel_right)
```

## config/boards/shields/tubetest/Kconfig.defconfig
```kconfig
if SHIELD_TUBETEST

# Name must be less than 16 characters long!
config ZMK_KEYBOARD_NAME
    default "TubeTest"

endif
```

## config/boards/shields/tubetest/Kconfig.shield
```kconfig
# No whitespace after the comma or in your part name!
config SHIELD_TUBETEST
    def_bool $(shields_list_contains, TubeTest)
```
